## meta-qca7k/conf/layer.conf
```bitbake
# We have a conf and classes directory, add to BBPATH
BBPATH .= ":${LAYERDIR}"

# We have recipes-* directories, add to BBFILES
BBFILES += "${LAYERDIR}/recipes-*/*/*.bb \
            ${LAYERDIR}/recipes-*/*/*.bbappend"

BBFILE_COLLECTIONS += "meta-qca7k"
BBFILE_PATTERN_meta-qca7k = "^${LAYERDIR}/"
BBFILE_PRIORITY_meta-qca7k = "6"

LAYERDEPENDS_meta-qca7k = "core"
LAYERSERIES_COMPAT_meta-qca7k = "thud"
```
